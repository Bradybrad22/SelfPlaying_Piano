/*
 * 61-Key Automatic Piano (C2~C7) using ESP32-C3 + 4×PCA9685
 * ------------------------------------------------------------------
 * 硬件:
 *   - ESP32-C3  (I2C: SDA=GPIO4, SCL=GPIO5)
 *   - 4 块 PCA9685 16 通道舵机驱动板 (地址 0x40,0x41,0x42,0x43)
 *   - 61 个舵机 (对应标准钢琴 61 键: MIDI 36 (C2) ~ 96 (C7))
 *   - 第 4 块板只使用通道 0..12 (13 个) 组成总计 61 通道
 * 供电:
 *   - 舵机独立 5V 大电流(建议≥10A, 依据舵机规格)。GND 与 ESP32 / PCA9685 共地。
 * 设计要点:
 *   - 每键按下只需顺时针 ~30° (以脉宽微增 ~300µs 模拟)
 *   - 非阻塞事件调度, 支持复音和弦
 *   - 可选校准模式: 针对单键差异增减按下脉宽 (offset)
 *   - 串口指令控制播放 / 调速 / 力度 / 校准
 *   - 示例曲目: 《月光奏鸣曲》第一乐章节选 + 分解和弦练习
 * 扩展方向:
 *   - 解析外部 MIDI 文件 (转换为 NoteEvent)
 *   - 多力度映射 (不同按下角度)
 *   - NVS 保存校准数据
 *
 * 串口指令 (115200):
 *   S            重新开始播放 (Start)
 *   P            暂停 / 继续 (Pause toggle)
 *   B <百分比>  设置速度缩放 (例如 B 120 = 比原谱快 20%)
 *   V <0-100>    设置力度 (影响额外按下角度/脉宽)
 *   L            输出当前事件索引 & 时间
 *   T <midi>     测试敲击该音 (按下->延时->回位)
 *   O <midi> <Δµs>  对该音符校准偏移 (pressOffset 增减)
 *   W            列出非零校准偏移
 *   R            清零全部校准偏移
 *
 * 若定义 CALIBRATION_MODE 则允许 O/T/R/W 命令; 未定义时忽略安全指令。
 */

#include <Arduino.h>
#include <Wire.h>

// ---- 重要: 提前声明结构体避免 "'KeyMap' has not been declared" ----
// Arduino IDE 会在编译前为 .ino 自动生成所有函数原型，如果函数参数里
// 出现 KeyMap 而结构体尚未定义，就会报这个错误。把结构体提前放到最前即可。
struct KeyMap { uint8_t driverIndex; uint8_t channel; };
// 你可以使用 Adafruit_PWMServoDriver 库; 这里手写一个精简驱动包装以减少依赖。

// ============ 可配置宏 =============================
#define SDA_PIN 4
#define SCL_PIN 5
#define I2C_FREQ 400000UL

#define CALIBRATION_MODE 1   // 发布最终版本可置 0 关闭校准命令

// 舵机脉宽参数 (依实际舵机调节)
#define SERVO_MIN_US 500     // 接近 0°
#define SERVO_MAX_US 2500    // 接近 180°

// 静止与按下基准脉宽 (可整体调整)
#define REST_PULSE_US 600    // 静止位置 (避免触键) - 需实测
#define PRESS_DELTA_US 300   // 按下时相对静止增加的脉宽 (~30°)
#define MIN_HOLD_MS  55      // 最小保持时间确保机械完成按键

// 力度映射 (V 命令影响) - 追加脉宽范围
#define VELOCITY_EXTRA_MIN 0
#define VELOCITY_EXTRA_MAX 200  // 追加最大 200µs -> 约再增加 ~20° (依舵机线性近似)

// 最大同时活动音数 (根据谱的复音数, 可适当增大)
#define MAX_ACTIVE_NOTES 20

// ============ PCA9685 Driver 封装 ==================
class PCA9685 {
public:
  explicit PCA9685(uint8_t addr=0x40):_addr(addr){}
  void begin(){
    // 软复位: 写 MODE1 寄存器 0x00 进入普通模式
    write8(0x00, 0x00); // MODE1
    delay(5);
    setPWMFreq(50);     // 默认 50Hz 伺服
  }
  void setPWMFreq(float freq){
    // 频率计算: prescale = round(25MHz / (4096*freq)) -1
    float prescaleval = (25000000.0f / (4096.0f * freq)) - 1.0f;
    uint8_t prescale = (uint8_t)floor(prescaleval + 0.5f);
    uint8_t oldmode = read8(0x00); // MODE1
    uint8_t sleep = (oldmode & 0x7F) | 0x10; // sleep
    write8(0x00, sleep);
    write8(0xFE, prescale);
    write8(0x00, oldmode);
    delay(5);
    write8(0x00, oldmode | 0xA1); // Auto-Increment + ALLCALL
  }
  void setPWM(uint8_t channel, uint16_t on, uint16_t off){
    uint8_t reg = 0x06 + 4*channel;
    Wire.beginTransmission(_addr);
    Wire.write(reg);
    Wire.write(on & 0xFF);
    Wire.write(on >> 8);
    Wire.write(off & 0xFF);
    Wire.write(off >> 8);
    Wire.endTransmission();
  }
private:
  uint8_t _addr;
  void write8(uint8_t reg, uint8_t val){
    Wire.beginTransmission(_addr);
    Wire.write(reg);
    Wire.write(val);
    Wire.endTransmission();
  }
  uint8_t read8(uint8_t reg){
    Wire.beginTransmission(_addr);
    Wire.write(reg);
    Wire.endTransmission();
    Wire.requestFrom((int)_addr, 1);
    if(Wire.available()) return Wire.read();
    return 0xFF;
  }
};

// ============ 全局数据结构 ========================

static const uint8_t driverAddrs[4] = {0x40,0x41,0x42,0x44};
PCA9685 drivers[4] = { PCA9685(0x40), PCA9685(0x41), PCA9685(0x42), PCA9685(0x44) };

// MIDI 范围
#define MIDI_LOW  36  // C2
#define MIDI_HIGH 96  // C7 (含)
#define KEY_COUNT (MIDI_HIGH - MIDI_LOW + 1) // 61

// 每键按下脉宽偏移 (校准微调, 单位 µs)
int16_t pressOffset[KEY_COUNT] = {0};

// 力度 (0~100)
uint8_t velocityPercent = 60;  // 默认中等力度

// 速度缩放 (百分比, 100 = 原速)
uint16_t tempoPercent = 100;

// 播放状态变量
bool paused = false;
uint32_t startMillis = 0;   // 播放起点参考
size_t currentEventIndex = 0;

// 事件定义
struct NoteEvent {
  uint32_t startMs;   // 相对起点毫秒
  uint16_t durMs;     // 按下持续时间
  uint8_t  midi;      // 音符号 (MIDI)
  uint8_t  vel;       // 0~127 (未来可用); 当前简单用
};

// 活动音管理
struct ActiveNote { uint8_t midi; uint32_t offTime; bool active; };
ActiveNote activeNotes[MAX_ACTIVE_NOTES];

// ============ 工具函数 ============================
inline int keyIndex(uint8_t midi){ return (midi < MIDI_LOW || midi > MIDI_HIGH) ? -1 : (midi - MIDI_LOW); }

// MIDI → (driver, channel)  (已在顶部声明 KeyMap, 这里不再重复定义)
inline bool mapMidi(uint8_t midi, KeyMap &km){
  if(midi < MIDI_LOW || midi > MIDI_HIGH) return false;
  uint8_t idx = midi - MIDI_LOW; // 0..60
  uint8_t driverIndex = idx / 16; // 0..3
  uint8_t channel = idx % 16;     // 0..15
  if(driverIndex == 3 && channel > 12) return false; // 超出最后板可用通道
  km.driverIndex = driverIndex; km.channel = channel; return true;
}

// 脉宽微步转换: 50Hz 周期 20000µs -> 1 step ≈ 4.8828µs
inline uint16_t usToCount(uint16_t us){ return (uint32_t)us * 4096UL / 20000UL; }

void setServoPulse(uint8_t midi, uint16_t pulseUs){
  KeyMap km; if(!mapMidi(midi, km)) return;
  if(pulseUs < SERVO_MIN_US) pulseUs = SERVO_MIN_US;
  if(pulseUs > SERVO_MAX_US) pulseUs = SERVO_MAX_US;
  uint16_t off = usToCount(pulseUs);
  drivers[km.driverIndex].setPWM(km.channel, 0, off);
}

uint16_t computePressPulse(uint8_t midi){
  int k = keyIndex(midi); if(k < 0) return REST_PULSE_US;
  // 基础按下
  int32_t pulse = REST_PULSE_US + PRESS_DELTA_US;
  // 力度追加 (线性)
  int32_t extra = (int32_t)VELOCITY_EXTRA_MIN + (int32_t)(velocityPercent) * (VELOCITY_EXTRA_MAX - VELOCITY_EXTRA_MIN) / 100;
  pulse += extra;
  // 单键校准
  pulse += pressOffset[k];
  if(pulse < SERVO_MIN_US) pulse = SERVO_MIN_US;
  if(pulse > SERVO_MAX_US) pulse = SERVO_MAX_US;
  return (uint16_t)pulse;
}

void noteOn(uint8_t midi, uint32_t now, uint32_t dur){
  // 找空位
  int slot = -1; for(int i=0;i<MAX_ACTIVE_NOTES;i++) if(!activeNotes[i].active){ slot=i; break; }
  if(slot < 0) return; // 忽略超载
  uint16_t pressPulse = computePressPulse(midi);
  setServoPulse(midi, pressPulse);
  uint32_t hold = dur < MIN_HOLD_MS ? MIN_HOLD_MS : dur;
  activeNotes[slot] = {midi, now + hold, true};
}

void scanNoteOff(uint32_t now){
  for(int i=0;i<MAX_ACTIVE_NOTES;i++) if(activeNotes[i].active && now >= activeNotes[i].offTime){
    setServoPulse(activeNotes[i].midi, REST_PULSE_US);
    activeNotes[i].active = false;
  }
}

// ============ 示例曲谱 (节选) =====================
// 为简洁, 这里只放少量事件; 你可以继续填充。
// 《月光奏鸣曲》op.27-2 第一乐章左手分解和右手旋律 (调至适配范围, 节奏近似)
// 时间单位: ms; 假设原速 BPM 52; 你后续可用 MIDI 解析替代。

// 宏帮助 (四分音符时值 = Q)
static const uint32_t Q = 1150; // 约等于 52BPM 的四分音符 ~1153ms 取整

// 快捷: nQ(分数) -> ms
#define DUR(frac) (uint32_t)((Q * (frac)))

// 下面是一个较短的片段 + 一个分解和弦练习 (Arpeggio Study)
/* 由 Acoustic_Piano_7_0.csv 自动转换
 * 假设结构:
 *   struct NoteEvent { uint32_t startMs; uint16_t durMs; uint8_t midi; uint8_t vel; };
 * 音符格式: { startMs, durMs, midi, vel }
 * 总事件数: 618  (SCORE_LEN)
 * 总时长约: 199 s
 */
const NoteEvent score[] PROGMEM = {
  {1074,15,45,30},
  {1084,525,77,73},
  {2354,2524,89,77},
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  {0xFFFFFFFF,0,0,0}
};

const size_t SCORE_LEN = 1388;




// ============ 播放调度 =============================

uint32_t scaledTime(){
  if(paused) return startMillis; // 暂停期间保持静止
  uint32_t elapsed = millis() - startMillis;
  // tempoPercent: 100 -> 原速; >100 更快 => 实际时间 = 原时间 * 100 / tempoPercent
  // 我们反向: 为了找到应触发的事件 startMs, 计算一个“虚拟谱时间” = elapsed * tempoPercent / 100
  uint32_t virtualT = (uint64_t)elapsed * tempoPercent / 100ULL;
  return virtualT;
}

void dispatch(){
  uint32_t vtime = scaledTime();
  // 触发符合条件的事件
  while(currentEventIndex < SCORE_LEN){
    NoteEvent ev; memcpy_P(&ev, &score[currentEventIndex], sizeof(NoteEvent));
    if(ev.startMs <= vtime){
      // 触发 NoteOn
      uint32_t durScaled = (uint64_t)ev.durMs * 100 / tempoPercent; // 速度加快则真实持续更短
      noteOn(ev.midi, millis(), durScaled);
      currentEventIndex++;
    } else break;
  }
}

void restartPlayback(){
  currentEventIndex = 0;
  startMillis = millis();
  paused = false;
  // 清空激活
  for(auto &a: activeNotes){
    if(a.active){ setServoPulse(a.midi, REST_PULSE_US); a.active=false; }
  }
}

// ============ 串口命令解析 ========================

void handleSerial(){
  if(!Serial.available()) return;
  String line = Serial.readStringUntil('\n');
  line.trim(); if(line.length()==0) return;
  // 拆分
  int sp1 = line.indexOf(' ');
  String cmd = (sp1<0)? line : line.substring(0, sp1);
  cmd.toUpperCase();
  String rest = (sp1<0)? "" : line.substring(sp1+1);

  if(cmd == "S"){
    restartPlayback();
    Serial.println(F("[S] Restart."));
  } else if(cmd == "P"){
    paused = !paused;
    if(!paused){ // 继续 -> 调整基准, 让 virtualTime 保持连续
      // 计算当前 virtualTime, 重新设置 startMillis
      uint32_t vt = scaledTime();
      startMillis = millis() - (uint64_t)vt * 100 / tempoPercent;
    }
    Serial.printf("[P] %s\n", paused?"Paused":"Resume");
  } else if(cmd == "B"){
    int val = rest.toInt(); if(val<30) val=30; if(val>400) val=400;
    tempoPercent = val;
    Serial.printf("[B] tempoPercent=%u\n", tempoPercent);
  } else if(cmd == "V"){
    int val = rest.toInt(); if(val<0) val=0; if(val>100) val=100;
    velocityPercent = val;
    Serial.printf("[V] velocityPercent=%u\n", velocityPercent);
  } else if(cmd == "L"){
    Serial.printf("[L] idx=%u/%u paused=%d tempo=%u vel=%u virtualT=%lu ms\n", (unsigned)currentEventIndex, (unsigned)SCORE_LEN, paused, tempoPercent, velocityPercent, (unsigned long)scaledTime());
  } else if(cmd == "T"){
#if CALIBRATION_MODE
    int midi = rest.toInt();
    if(keyIndex(midi)>=0){ noteOn(midi, millis(), 120); Serial.printf("[T] midi %d test.\n", midi); }
    else Serial.println(F("[T] invalid midi"));
#endif
  } else if(cmd == "O"){
#if CALIBRATION_MODE
    // O <midi> <delta>
    int sp = rest.indexOf(' ');
    if(sp>0){
      int midi = rest.substring(0, sp).toInt();
      int delta = rest.substring(sp+1).toInt();
      int k = keyIndex(midi);
      if(k>=0){ pressOffset[k] += delta; Serial.printf("[O] midi %d offset=%d\n", midi, pressOffset[k]); }
      else Serial.println(F("[O] invalid midi"));
    }
#endif
  } else if(cmd == "W"){
#if CALIBRATION_MODE
    Serial.println(F("[W] Non-zero offsets:"));
    for(int i=0;i<KEY_COUNT;i++) if(pressOffset[i]!=0){ Serial.printf("  midi %d : %d\n", i+MIDI_LOW, pressOffset[i]); }
#endif
  } else if(cmd == "R"){
#if CALIBRATION_MODE
    for(int i=0;i<KEY_COUNT;i++) pressOffset[i]=0;
    Serial.println(F("[R] All offsets cleared."));
#endif
  } else {
    Serial.println(F("[?] Unknown command"));
  }
}

// ============ 自检 (可选) =========================
void selfTest(){
  Serial.println(F("[SelfTest] sequential press..."));
  for(uint8_t midi=MIDI_LOW; midi<=MIDI_HIGH; ++midi){
    KeyMap km; if(!mapMidi(midi, km)) continue;
    setServoPulse(midi, computePressPulse(midi));
    delay(30);
    setServoPulse(midi, REST_PULSE_US);
    delay(15);
  }
  Serial.println(F("[SelfTest] done."));
}

// ============ SETUP & LOOP ========================
void setup(){
  Serial.begin(115200);
  while(!Serial && millis()<3000){};
  Serial.println(F("\n[Init] 61-Key Piano Controller"));
  Wire.begin(SDA_PIN, SCL_PIN);
  Wire.setClock(I2C_FREQ);

  for(int i=0;i<4;i++){ Serial.printf("[Init] Driver %d @0x%02X...", i, driverAddrs[i]); drivers[i].begin(); Serial.println(F("OK")); }
  // 归零所有键
  for(uint8_t midi=MIDI_LOW; midi<=MIDI_HIGH; ++midi){ setServoPulse(midi, REST_PULSE_US); }

  memset(activeNotes, 0, sizeof(activeNotes));
  restartPlayback();

  // 如需首次自检，可打开:
  // selfTest();
  Serial.println(F("[Ready] Commands: S P B V L T O W R"));
}

void loop(){
  handleSerial();
  if(!paused){
    dispatch();
  }
  scanNoteOff(millis());
}

// =================== 结束 =========================
// 后续扩展: 
// 1. MIDI 文件解析: 解析 delta-time -> 生成 NoteEvent 数组
// 2. 脚踏板: 通过延迟释放时间模拟延音 (可加 sustain flag)
// 3. EEPROM/NVS: 保存 pressOffset 校准
// 4. 动态队列: 使用最小堆按 startMs 排序支持超长曲目分段加载
// ==================================================
